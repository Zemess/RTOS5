## CMakeLists.txt
```
cmake_minimum_required(VERSION 3.16)
project(TimeParserTest CXX)
set(CMAKE_CXX_STANDARD 17)

# Lisää Googletest
add_subdirectory(googletest)
include_directories(googletest/googletest/include)

# Lähdekoodit
add_executable(runTests
    TimeParser.cpp
    test_cases/TimeParserTest.cpp
)
# lisää projektijuuri include-poluksi
target_include_directories(runTests PRIVATE ${CMAKE_CURRENT_SOURCE_DIR})

target_link_libraries(runTests gtest gtest_main)
```

## prj.conf
```kconfig
CONFIG_GPIO=y
CONFIG_MAIN_STACK_SIZE=1024
CONFIG_PRINTK=y
CONFIG_THREAD_NAME=y
CONFIG_CONSOLE=y
CONFIG_STDOUT_CONSOLE=y

# Timerit käyttöön
CONFIG_TIMING_FUNCTIONS=y
CONFIG_CORTEX_M_DWT=y

# UART driverit käyttöön
CONFIG_SERIAL=y
CONFIG_UART_INTERRUPT_DRIVEN=y

# FIFO ja malloc käyttöön
CONFIG_HEAP_MEM_POOL_SIZE=1024
CONFIG_SYSTEM_WORKQUEUE_STACK_SIZE=1024

# Debug-tulosteiden varmuus
CONFIG_LOG=y
CONFIG_LOG_DEFAULT_LEVEL=3
```

## src/time_parser.h
```c
#pragma once
// Palauttaa: >0 sekunnit, <0 virhekoodi
enum {
    TP_OK = 0,
    TP_ERR_NULL   = -1,
    TP_ERR_LEN    = -2,
    TP_ERR_NAN    = -3,
    TP_ERR_RANGEH = -4,
    TP_ERR_RANGEM = -5,
    TP_ERR_RANGES = -6,
    TP_ERR_ZERO   = -7
};

int time_parse(const char *hhmmss);
```

## src/uartDef.c
```c
#include "uartDef.h"
#include "dispatcher.h"
#include "time_parser.h"
#include "debug.h"

#include <zephyr/drivers/uart.h>
#include <zephyr/sys/printk.h>
#include <zephyr/kernel.h>
#include <zephyr/device.h>
#include <zephyr/timing/timing.h>

#include <string.h>
#include <ctype.h>

#define UART_DEVICE_NODE DT_CHOSEN(zephyr_shell_uart)
static const struct device *const uart_dev = DEVICE_DT_GET(UART_DEVICE_NODE);

/* Aikamerkkijonon keruu: 'T' + 6 numeroa */
static char tbuf[7];     // 6 numeroa + '\0'
static int  ti = -1;     // -1 = ei kerätä, 0..6 = kerätään
static uint64_t uart_start_time = 0;

static void uart_cb(const struct device *dev, void *user_data) {
    uint8_t c;

    if (uart_irq_update(dev) && uart_irq_rx_ready(dev)) {
        while (uart_fifo_read(dev, &c, 1) == 1) {

            if (c == '\r' || c == '\n') {
                continue; // ohita rivinvaihdot
            }

            /* Jos keruu on käynnissä (T on vastaanotettu) */
            if (ti >= 0) {
                if (isdigit((unsigned char)c) && ti < 6) {
                    tbuf[ti++] = (char)c;

                    if (ti == 6) {
                        tbuf[6] = '\0';
                        ti = -1; // lopeta keruu

                        int seconds = time_parse(tbuf);

                        dispatcher_event_t evt = {0};
                        evt.type = EVENT_TIMER_START;
                        evt.seconds = (seconds > 0) ? seconds : 0;
                        strcpy(evt.msg, "TIMER");
                        dispatcher_post(&evt);

                        /* Kesto T:stä siihen kun postataan timer-start */
                        uint64_t delta = timing_cycles_to_ns(timing_counter_get() - uart_start_time) / 1000;
                        DBG("UART command handling time: %llu us\n", (unsigned long long)delta);
                        
                        uint64_t delta_us = timing_cycles_to_ns(timing_counter_get() - uart_start_time) / 1000;
                        DBG("UART: parsed time '%s' = %d s, handle=%llu us\n", tbuf, seconds, (unsigned long long)delta_us);

                        if (seconds > 0) {
                            DBG("UART: parsed time '%s' = %d s, handle=%llu us\n",
                                tbuf, seconds, delta_us);
                        } else {
                            DBG("UART: time parse error %d for '%s', handle=%llu us\n",
                                seconds, tbuf, delta_us);
                        }
                    }
                } else {
                    /* Ei numero -> mitätöi keruu */
                    DBG("UART: invalid time char '%c' -> reset\n", c);
                    ti = -1;
                }
                continue; // älä käsittele tätä merkkiä enää LED-casena
            }

            /* Aloita keruu komennolla 'T' tai 't' */
            if (c == 'T' || c == 't') {
                ti = 0;
                uart_start_time = timing_counter_get();
                DBG("UART: starting time collection\n");
                continue;
            }

            /* Muut yksimerkkikomennot kuten ennen */
            dispatcher_event_t evt = { .type = EVENT_LED_CMD };
            evt.msg[0] = (char)c;
            evt.msg[1] = '\0';
            dispatcher_post(&evt);
        }
    }
}

void uartDef_init(void) {
    if (!device_is_ready(uart_dev)) {
        DBG("Error: UART device not ready\n");
        return;
    }
    uart_irq_callback_user_data_set(uart_dev, uart_cb, NULL);
    uart_irq_rx_enable(uart_dev);
    DBG("UART initialized with RX interrupt\n");
}
```
